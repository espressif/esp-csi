## Kconfig
```kconfig
menu "ESP Wi-Fi Radar Configuration"
    config CSI_PACK_NUM
        int "Number of data packets in one analysis"
        default 50
        help
            Number of data packets in one analysis
endmenu
```

## examples/connect_qcloud/main/Kconfig.projbuild
```kconfig
menu "ESP QCloud Example Configuration"
    menu "Light development board selection "
        choice LIGHT_TYPE
            prompt "light hardware type"
            default LIGHT_TYPE_MOONLIGHT
            help
                Choose different types of lamp development boards.
    
            config LIGHT_TYPE_MOONLIGHT
                bool "ESP32 moonlight"
            config LIGHT_TYPE_MESHKIT
                bool "ESP32-MeshKit Light"
            config LIGHT_TYPE_CUSTOM
                bool "Custom"
        endchoice

        config LIGHT_GPIO_RED
            int "Light red pin GPIO number"
            depends on LIGHT_TYPE_CUSTOM
            range 0 46
            default 25
            help
                There are more enumerations like that
                up to GPIO39, excluding GPIO20, GPIO24 and GPIO28..31.
                They are not shown here to reduce redundant information.
                @note GPIO34..39 are input mode only.
        
        config LIGHT_GPIO_GREEN
            int "Light green pin GPIO number"
            depends on LIGHT_TYPE_CUSTOM
            range 0 46
            default 26
            help
                There are more enumerations like that
                up to GPIO39, excluding GPIO20, GPIO24 and GPIO28..31.
                They are not shown here to reduce redundant information.
                @note GPIO34..39 are input mode only.
        
        config LIGHT_GPIO_BLUE
            int "Light blue pin GPIO number"
            depends on LIGHT_TYPE_CUSTOM
            range 0 46
            default 27
            help
                There are more enumerations like that
                up to GPIO39, excluding GPIO20, GPIO24 and GPIO28..31.
                They are not shown here to reduce redundant information.
                @note GPIO34..39 are input mode only.
        
        config LIGHT_GPIO_COLD
            int "Light cold color pin GPIO number"
            depends on LIGHT_TYPE_CUSTOM
            range 0 46
            default 23
            help
                There are more enumerations like that
                up to GPIO39, excluding GPIO20, GPIO24 and GPIO28..31.
                They are not shown here to reduce redundant information.
                @note GPIO34..39 are input mode only.
        
        config LIGHT_GPIO_WARM
            int "Light warm color pin GPIO number"
            depends on LIGHT_TYPE_CUSTOM
            range 0 46
            default 19
            help
                There are more enumerations like that
                up to GPIO39, excluding GPIO20, GPIO24 and GPIO28..31.
                They are not shown here to reduce redundant information.
                @note GPIO34..39 are input mode only.
        
        config LIGHT_FADE_PERIOD_MS
            int "The time from the current color to the next color"
            default 500
            help
                The time from the current color to the next color.
        
        config LIGHT_BLINK_PERIOD_MS
            int "Period of blinking lights"
            default 3000
            help
                Period of blinking lights.
    endmenu

menu "Light provisioning network selection"
        config LIGHT_PROVISIONING_SMARTCONFIG
            bool "Enable SmartConfig's smart network configuration method"
            default y
            help
                Enable SmartConfig's smart network configuration method
        
        config LIGHT_PROVISIONING_SOFTAPCONFIG
            bool "Enable SoftAP's network configuration method"
            default y
            help
                "Enable SoftAP's network configuration method"

        config LIGHT_PROVISIONING_SOFTAPCONFIG_SSID
            depends on LIGHT_PROVISIONING_SOFTAPCONFIG
            string "SoftAP ssid"
            default "tcloud_XXX"
            help
                SSID (network name) for the phone to connect to.

        config LIGHT_PROVISIONING_SOFTAPCONFIG_PASSWORD
            depends on LIGHT_PROVISIONING_SOFTAPCONFIG
            string "SoftAP password"
            default ""
            help
                WiFi password (WPA or WPA2) for the example to use.
                Can be left blank if the network has no security set.
    endmenu

    config LIGHT_REBOOT_UNBROKEN_COUNT_RESET
        int "More than this number of continuous uninterrupted restarts triggers a reset of the device"
        range 3 15
        default 5
        help
            Devices without buttons trigger a device reset through continuous restart.

    config LIGHT_DEBUG
        bool "The device will be in debug mode"
        default n
        help
            Debug mode device performance is only used during development.

endmenu
```

## examples/connect_qcloud/sdkconfig.defaults.esp32s2
```kconfig
#
# Serial flasher config
#
CONFIG_ESPTOOLPY_FLASHSIZE_4MB=y
CONFIG_ESPTOOLPY_FLASHMODE_QIO=y
CONFIG_ESPTOOLPY_FLASHFREQ_80M=y
CONFIG_ESPTOOLPY_BAUD_921600B=y

#
# Partition Table
#
CONFIG_PARTITION_TABLE_OFFSET=0xc000
CONFIG_PARTITION_TABLE_CUSTOM=y
CONFIG_PARTITION_TABLE_CUSTOM_FILENAME="${QCLOUD_PATH}/config/partition_table/partitions_4MB.csv"

#
# ESP HTTPS OTA
#
CONFIG_OTA_ALLOW_HTTP=y

#
# FreeRTOS
#
CONFIG_FREERTOS_HZ=1000
CONFIG_FREERTOS_UNICORE=y
CONFIG_FREERTOS_USE_TRACE_FACILITY=y
CONFIG_FREERTOS_USE_STATS_FORMATTING_FUNCTIONS=y
CONFIG_FREERTOS_VTASKLIST_INCLUDE_COREID=y
CONFIG_FREERTOS_GENERATE_RUN_TIME_STATS=y
CONFIG_FREERTOS_TIMER_TASK_STACK_DEPTH=3072

CONFIG_ESP_TIMER_TASK_STACK_SIZE=4096
CONFIG_ESP_TASK_WDT_PANIC=y
CONFIG_ESP_TASK_WDT_TIMEOUT_S=10

#
# ESP32S2-specific
#
CONFIG_ESP32S2_ENABLE_COREDUMP=y
CONFIG_ESP32S2_ENABLE_COREDUMP_TO_FLASH=y
CONFIG_ESP32S2_DEFAULT_CPU_FREQ_240=y

#
# Wi-Fi
#
CONFIG_ESP32_WIFI_CSI_ENABLED=y
CONFIG_ESP32_WIFI_AMPDU_TX_ENABLED=N
CONFIG_ESP32_WIFI_AMPDU_RX_ENABLED=N
CONFIG_ESP32_WIFI_STATIC_RX_BUFFER_NUM=6
CONFIG_ESP32_WIFI_DYNAMIC_RX_BUFFER_NUM=12
CONFIG_ESP32_WIFI_DYNAMIC_TX_BUFFER=y
CONFIG_ESP32_WIFI_TX_BUFFER_TYPE=1
CONFIG_ESP32_WIFI_DYNAMIC_TX_BUFFER_NUM=12
CONFIG_ESP32_WIFI_TX_BA_WIN=6
CONFIG_ESP32_WIFI_RX_BA_WIN=6
CONFIG_LWIP_TCP_SND_BUF_DEFAULT=12288
CONFIG_LWIP_TCP_WND_DEFAULT=12288

#
# Bluetooth
#
CONFIG_BT_ENABLED=y

#
# ESP-TLS
#
CONFIG_ESP_TLS_INSECURE=y
CONFIG_ESP_TLS_SKIP_SERVER_CERT_VERIFY=y
```

## examples/connect_rainmaker/sdkconfig.defaults
```kconfig
#
# Serial flasher config
#
CONFIG_ESPTOOLPY_FLASHMODE_QIO=y
CONFIG_ESPTOOLPY_FLASHFREQ_80M=y

#
# Partition Table
#
CONFIG_PARTITION_TABLE_CUSTOM=y
CONFIG_PARTITION_TABLE_CUSTOM_FILENAME="partitions.csv"

#
# Wi-Fi
#
CONFIG_ESP32_WIFI_CSI_ENABLED=y
CONFIG_ESP32_WIFI_AMPDU_TX_ENABLED=
CONFIG_ESP32_WIFI_AMPDU_RX_ENABLED=

#
# LWIP
#
CONFIG_LWIP_IRAM_OPTIMIZATION=y

#
# Common ESP-related
#
CONFIG_ESP_CONSOLE_UART_CUSTOM=y
CONFIG_ESP_CONSOLE_UART=y
CONFIG_ESP_CONSOLE_UART_NUM=0
CONFIG_ESP_TASK_WDT_TIMEOUT_S=30

#
# Compiler options
#
# CONFIG_COMPILER_OPTIMIZATION_PERF=y

#
# FreeRTOS
#
CONFIG_FREERTOS_HZ=1000

#
# ESP32-specific
#
CONFIG_ESP32_DEFAULT_CPU_FREQ_240=y
CONFIG_ESP32_DEFAULT_CPU_FREQ_MHZ=240

CONFIG_ESP32_WIFI_DYNAMIC_TX_BUFFER_NUM=32

#
# ESP32S3-specific
#
CONFIG_ESP32S3_DEFAULT_CPU_FREQ_240=y
CONFIG_ESP32S3_DEFAULT_CPU_FREQ_MHZ=240

# mbedtls
CONFIG_MBEDTLS_DYNAMIC_BUFFER=y
CONFIG_MBEDTLS_DYNAMIC_FREE_PEER_CERT=y
CONFIG_MBEDTLS_DYNAMIC_FREE_CONFIG_DATA=y
CONFIG_MBEDTLS_CERTIFICATE_BUNDLE_DEFAULT_CMN=y
CONFIG_MBEDTLS_TLS_CLIENT_ONLY=y

# For BLE Provisioning using NimBLE stack (Not applicable for ESP32-S2)
CONFIG_BT_ENABLED=y
CONFIG_BTDM_CTRL_MODE_BLE_ONLY=y
CONFIG_BT_NIMBLE_ENABLED=y

# Temporary Fix for Timer Overflows
CONFIG_FREERTOS_TIMER_TASK_STACK_DEPTH=3120

# For additional security on reset to factory
CONFIG_ESP_RMAKER_USER_ID_CHECK=y

# Secure Local Control
CONFIG_ESP_RMAKER_LOCAL_CTRL_ENABLE=y
CONFIG_ESP_RMAKER_LOCAL_CTRL_SECURITY_1=y

# Application Rollback
CONFIG_BOOTLOADER_APP_ROLLBACK_ENABLE=y
```

## examples/console_test/components/ws2812_led/Kconfig
```kconfig
menu "WS2812 RGB LED"

    config WS2812_LED_ENABLE
        bool "Enable RGB LED"
        default n if IDF_TARGET_ESP32
        default y
        help
            Disable the WS2812 RGB LED.

    config WS2812_LED_GPIO
        int "WS2812 LED GPIO"
        default 8 if IDF_TARGET_ESP32C3
        default 48 if IDF_TARGET_ESP32S3
        default 18
        depends on WS2812_LED_ENABLE
        help
            Set the WS2812 RGB LED GPIO.

endmenu
```

## examples/console_test/sdkconfig.defaults
```kconfig
#
# Wi-Fi
#
CONFIG_ESP32_WIFI_CSI_ENABLED=y
CONFIG_ESP32_WIFI_AMPDU_TX_ENABLED=N
CONFIG_ESP32_WIFI_AMPDU_RX_ENABLED=N

#
# Common ESP-related
#
CONFIG_ESP_CONSOLE_UART_CUSTOM=y
CONFIG_ESP_CONSOLE_UART=y
CONFIG_ESP_CONSOLE_UART_NUM=0
CONFIG_ESP_TASK_WDT_TIMEOUT_S=10
```

## examples/esp-radar/connect_rainmaker/sdkconfig.defaults
```kconfig
CONFIG_BOOTLOADER_APP_ROLLBACK_ENABLE=y
CONFIG_ESPTOOLPY_FLASHMODE_QIO=y
CONFIG_ESPTOOLPY_FLASHFREQ_80M=y
CONFIG_PARTITION_TABLE_CUSTOM=y
CONFIG_ESP_RMAKER_USER_ID_CHECK=y
CONFIG_ESP_RMAKER_LOCAL_CTRL_ENABLE=y
CONFIG_BT_NIMBLE_ENABLED=y
CONFIG_ESP_DEFAULT_CPU_FREQ_MHZ_240=y
CONFIG_ESP_TASK_WDT_TIMEOUT_S=30
CONFIG_ESP_WIFI_CSI_ENABLED=y
# CONFIG_ESP_WIFI_AMPDU_TX_ENABLED is not set
# CONFIG_ESP_WIFI_AMPDU_RX_ENABLED is not set
# CONFIG_ESP_WIFI_IRAM_OPT is not set
CONFIG_FREERTOS_HZ=1000
CONFIG_FREERTOS_TIMER_TASK_STACK_DEPTH=3120
CONFIG_MBEDTLS_DYNAMIC_BUFFER=y
CONFIG_MBEDTLS_DYNAMIC_FREE_CONFIG_DATA=y
CONFIG_MBEDTLS_CERTIFICATE_BUNDLE_DEFAULT_CMN=y
```

## examples/esp-radar/console_test/sdkconfig.defaults
```kconfig
#
# Serial flasher config
#
CONFIG_ESPTOOLPY_FLASHMODE_QIO=y
CONFIG_ESPTOOLPY_FLASHFREQ_80M=y
CONFIG_ESPTOOLPY_BAUD_921600B=y
CONFIG_ESPTOOLPY_FLASHSIZE_4MB=y
CONFIG_ESPTOOLPY_MONITOR_BAUD_2MB=y
CONFIG_ESP_CONSOLE_UART_BAUDRATE=2000000

#
# Partition Table
#
CONFIG_PARTITION_TABLE_CUSTOM=y
CONFIG_PARTITION_TABLE_CUSTOM_FILENAME="partitions.csv"

#
# Wi-Fi
#
CONFIG_ESP32_WIFI_CSI_ENABLED=y
CONFIG_ESP32_WIFI_AMPDU_TX_ENABLED=

#
# Common ESP-related
#
CONFIG_ESP_CONSOLE_UART_CUSTOM=y
CONFIG_ESP_CONSOLE_UART=y
CONFIG_ESP_CONSOLE_UART_NUM=0
CONFIG_ESP_TASK_WDT_TIMEOUT_S=30

#
# Compiler options
#
CONFIG_COMPILER_OPTIMIZATION_PERF=y

#
# FreeRTOS
#
CONFIG_FREERTOS_HZ=1000

#
# ESP32-specific
#
CONFIG_ESP32_DEFAULT_CPU_FREQ_240=y
CONFIG_ESP32_DEFAULT_CPU_FREQ_MHZ=240

CONFIG_ESP32_WIFI_DYNAMIC_TX_BUFFER_NUM=32

#
# ESP32S3-specific
#
CONFIG_ESP32S3_DEFAULT_CPU_FREQ_240=y
CONFIG_ESP32S3_DEFAULT_CPU_FREQ_MHZ=240
```

## examples/get-started/csi_recv/sdkconfig.defaults
```kconfig
#
# Wi-Fi
#
CONFIG_ESP32_WIFI_CSI_ENABLED=y
CONFIG_ESP32_WIFI_AMPDU_TX_ENABLED=
CONFIG_ESP32_WIFI_DYNAMIC_RX_BUFFER_NUM=128

#
# UART 
#
CONFIG_ESP_CONSOLE_UART_CUSTOM=y
CONFIG_ESP_CONSOLE_UART=y
CONFIG_ESP_CONSOLE_UART_NUM=0
CONFIG_CONSOLE_UART_BAUDRATE=921600

CONFIG_ESP_TASK_WDT_TIMEOUT_S=30

CONFIG_ESPTOOLPY_MONITOR_BAUD_921600B=y
CONFIG_ESPTOOLPY_MONITOR_BAUD=921600
```

## examples/get-started/csi_recv_router/sdkconfig.defaults
```kconfig
#
# Wi-Fi
#
CONFIG_ESP32_WIFI_CSI_ENABLED=y
CONFIG_ESP32_WIFI_AMPDU_TX_ENABLED=
CONFIG_ESP32_WIFI_DYNAMIC_RX_BUFFER_NUM=128

#
# UART 
#
CONFIG_ESP_CONSOLE_UART_CUSTOM=y
CONFIG_ESP_CONSOLE_UART=y
CONFIG_ESP_CONSOLE_UART_NUM=0
CONFIG_CONSOLE_UART_BAUDRATE=921600

CONFIG_ESP_TASK_WDT_TIMEOUT_S=30

CONFIG_ESPTOOLPY_MONITOR_BAUD_921600B=y
CONFIG_ESPTOOLPY_MONITOR_BAUD=921600


#
# Wi-Fi
#
CONFIG_ESP32_WIFI_CSI_ENABLED=y
CONFIG_ESP32_WIFI_AMPDU_TX_ENABLED=
CONFIG_ESP32_WIFI_AMPDU_RX_ENABLED=

#
# Compiler options
#
CONFIG_COMPILER_OPTIMIZATION_PERF=y

#
# FreeRTOS
#
CONFIG_FREERTOS_HZ=1000

#
# ESP32-specific
#
CONFIG_ESP32_DEFAULT_CPU_FREQ_240=y
CONFIG_ESP32_DEFAULT_CPU_FREQ_MHZ=240

CONFIG_ESP32_WIFI_DYNAMIC_TX_BUFFER_NUM=32

#
# ESP32S3-specific
#
CONFIG_ESP32S3_DEFAULT_CPU_FREQ_240=y
CONFIG_ESP32S3_DEFAULT_CPU_FREQ_MHZ=240
```

## examples/get-started/csi_send/sdkconfig.defaults
```kconfig
#
# Wi-Fi
#
CONFIG_ESP32_WIFI_CSI_ENABLED=y
CONFIG_ESP32_WIFI_AMPDU_TX_ENABLED=
CONFIG_ESP32_WIFI_DYNAMIC_TX_BUFFER_NUM=128

#
# FreeRTOS
#
CONFIG_FREERTOS_HZ=1000
```

## sdkconfig.defaults
```kconfig
# Override some defaults in application project.

#
# Serial flasher config
#
CONFIG_ESPTOOLPY_FLASHSIZE_4MB=y
CONFIG_ESPTOOLPY_FLASHMODE_QIO=y
CONFIG_ESPTOOLPY_FLASHFREQ_80M=y
CONFIG_ESPTOOLPY_BAUD_921600B=y

#
# Partition Table
#
CONFIG_PARTITION_TABLE_OFFSET=0xc000
CONFIG_PARTITION_TABLE_CUSTOM=y
CONFIG_PARTITION_TABLE_CUSTOM_FILENAME="${QCLOUD_PATH}/config/partition_table/partitions_4MB.csv"

#
# ESP HTTPS OTA
#
CONFIG_OTA_ALLOW_HTTP=y

#
# FreeRTOS
#
CONFIG_FREERTOS_HZ=1000
CONFIG_FREERTOS_UNICORE=y
CONFIG_FREERTOS_USE_TRACE_FACILITY=y
CONFIG_FREERTOS_USE_STATS_FORMATTING_FUNCTIONS=y
CONFIG_FREERTOS_VTASKLIST_INCLUDE_COREID=y
CONFIG_FREERTOS_GENERATE_RUN_TIME_STATS=y
CONFIG_FREERTOS_TIMER_TASK_STACK_DEPTH=3072

CONFIG_ESP_TIMER_TASK_STACK_SIZE=4096
CONFIG_ESP_TASK_WDT_PANIC=y
CONFIG_ESP_TASK_WDT_TIMEOUT_S=10

#
# ESP32-specific
#
CONFIG_ESP32_ENABLE_COREDUMP=y
CONFIG_ESP32_ENABLE_COREDUMP_TO_FLASH=y
CONFIG_ESP32_DEFAULT_CPU_FREQ_240=y
CONFIG_ESP32_DEFAULT_CPU_FREQ_MHZ=240

CONFIG_ESP32_WIFI_STATIC_RX_BUFFER_NUM=8
CONFIG_ESP32_WIFI_DYNAMIC_RX_BUFFER_NUM=24
CONFIG_ESP32_WIFI_DYNAMIC_TX_BUFFER_NUM=24
CONFIG_ESP32_WIFI_AMPDU_TX_ENABLED=y
CONFIG_ESP32_WIFI_TX_BA_WIN=16
CONFIG_ESP32_WIFI_AMPDU_RX_ENABLED=y
CONFIG_ESP32_WIFI_RX_BA_WIN=16

CONFIG_LWIP_TCP_SND_BUF_DEFAULT=28000
CONFIG_LWIP_TCP_WND_DEFAULT=28000
CONFIG_LWIP_TCP_RECVMBOX_SIZE=32
CONFIG_LWIP_UDP_RECVMBOX_SIZE=32
CONFIG_LWIP_TCPIP_RECVMBOX_SIZE=32
```
